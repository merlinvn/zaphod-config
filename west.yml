## west.yml
```yaml
manifest:
  remotes:
    - name: zmkfirmware
      url-base: https://github.com/zmkfirmware
    - name: petejohanson
      url-base: https://github.com/petejohanson
    - name: nickconway
      url-base: https://github.com/nickconway
    - name: urob
      url-base: https://github.com/urob
  projects:
    # - name: zmk
    #   remote: zmkfirmware
    #   revision: main
    #   import: app/west.yml
    # - name: zmk
    #   remote: nickconway
    #   revision: leader-key
    #   import: app/west.yml
    - name: zmk
      remote: nickconway
      revision: smart-interrupt
      import: app/west.yml
    # - name: zmk
    #   remote: urob
    #   revision: main
    #   import: app/west.yml
  self:
    path: config
```
