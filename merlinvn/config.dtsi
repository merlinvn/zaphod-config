#define BASE_L 0
#define QW_L 1
#define VI_L 2
#define NAV_L 3
#define OTH_L 4
#define NUM_L 5
#define SYM_L 6
#define FUN_L 7
#define MED_L 8

// Using layer taps on thumbs, having quick tap as well helps w/ repeating space/backspace
// &lt { quick_tap_ms = <200>; };

&sl { release-after-ms = <500>; };
&sk {
    release-after-ms = <500>;
    quick-release;
};

&caps_word {
  continue-list = <UNDERSCORE MINUS BSPC LSHFT RSHFT>;
};

&key_repeat {
    usage-pages = <HID_USAGE_KEY HID_USAGE_CONSUMER>;
};


